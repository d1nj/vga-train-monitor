/include/ "system-conf.dtsi"
/ {
/*
	memory {
		device_type = "memory";
		reg = <0x0 0x20000000>, <0x40000000 0x8000>;
   	};
 	reserved-memory {
		ranges;
		reserved {
			reg = <0x40000000 0x8000>;
		};
	};
	*/
};
&axi_bram_ctrl_0 {
    status = "disabled";
};
